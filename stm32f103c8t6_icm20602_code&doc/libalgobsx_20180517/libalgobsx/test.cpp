#include <stdio.h>
#include <math.h>
extern "C" {
//#include "BsxFusionLibrary.h"
#include "BsxLibraryConfiguration.h"
#include "InternalDataTypes.h"
#include "MathOperations.h"
#include "MatrixOperations.h"
#include "invSqrt.h"
}
uint8_t ACC_Spec[37] = {37,0,3,1,0,9,12,150,0,16,60,0,1,0,1,0,176,4,82,3,0,0,64,65,1,1,1,1,2,2,2,3,3,1,1,180,115}; /* BMI160 */
uint8_t MAG_Spec[39] = {39,0,2,1,20,5,20,5,196,9,6,9,112,23,0,0,128,61,205,204,76,63,0,0,224,64,1,1,1,1,1,1,1,1,1,1,1,134,84}; /* BMM150 */
//uint8_t GYRO_Spec[14] = {14,0,1,1,3,9,12,136,19,16,1,1,129,46}; /* bmg160 */
uint8_t GYRO_Spec[14] = {14,0,1,1,4,9,12,136,19,16,1,1,137,48}; /* bmg160 */
uint8_t USE_Case[] = { 116,6,1,1,0,0,0,0,0,0,0,0,0,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51,
                             179,62,205,204,12,63,205,204,12,63,51,51,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183,
                             209,56,0,0,0,0,0,0,0,0,0,0,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128,
                             63,0,0,0,0,0,0,0,0,0,0,0,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51,
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                             0,0,0,0,0,0,0,0,0,0,0,0,0,0,0,0,0,7,4,3,0,0,0,0,0,0,10,3,4,25,64,18,24,0,64,114,8,0,13,226,109
                           }; /* BSXLite Usecase configuration string */

//unsigned char bma_spec[] = { 37, 0, 2, 1, 0, 7, 9, 150, 0, 12, 180, 0, 5, 0, 1, 0, 176, 4, 82, 3, 0, 0, 64, 65, 1, 1, 1, 1, 2, 2, 2, 3, 3, 1, 1, 172, 167};  /* bma255 */
unsigned char bma_spec[] = { 37, 0, 2, 1, 0, 7, 9, 150, 0, 16, 180, 0, 5, 0, 1, 0, 176, 4, 82, 3, 0, 0, 64, 65, 1, 1, 1, 1, 2, 2, 2, 3, 3, 1, 1, 20, 169};   /* bma255 */
//unsigned char bmg_spec[] = { 14, 0, 1, 1, 1, 7, 200, 136, 19, 16, 1, 1, 203, 8};  /* bmg160 */
unsigned char bmg_spec[] = { 14, 0, 1, 1, 4, 7, 200, 136, 19, 16, 1, 1, 227, 22};  /* bmg160 */
unsigned char bmg_spec1[] = { 
  0x0E,
  0x00,
  0x01,
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  0x71,
  0x2A
};
unsigned char bmm_spec[] = { 39, 0, 2, 1, 20, 5, 20, 5, 196, 9, 7, 7, 112, 23, 0, 0, 128, 61, 205, 204, 76, 63, 0, 0, 32, 65, 1, 1, 1, 1, 1, 1, 1, 1, 1, 1, 1, 185, 185};  /* bmm150 */

int main(int argc, char* argv[]) {
  char firmware_path[255];
  char spec_path[255];
  /* bmi160 */
  //sprintf(input_path, "../../../Bosch_PCB_7183_di01_BMI160-7183_di01.2.1.10836_170103.fw");
  //sprintf(firmware_path, "../../../Bosch_PCB_7183_di01_BMI160-7183_di01.2.1.10836_170103_lengyansong.fw");
  //sprintf(firmware_path, "../../../Bosch_PCB_7183_di01_BMI160_BMM150-7183_di01.2.1.10836_170103.fw");
  //sprintf(firmware_path, "../../../Bosch_PCB_7183_di01_BMI160_AK09911-7183_di01.2.1.10836_170103.fw");
  //sprintf(firmware_path, "../../../Bosch_PCB_7183_di01_BMI160_AK09912-7183_di01.2.1.10836_170103.fw");
  //sprintf(firmware_path, "../../../Bosch_PCB_7183_di01_BMI160_YAS532B-7183_di01.2.1.10836_170103.fw");
  /* bmi160b */
  //sprintf(firmware_path, "../../../Bosch_PCB_7183_di03_BMI160-7183_di03.2.1.11696_170103.fw");
  //sprintf(firmware_path, "../../../Bosch_PCB_7183_di03_BMI160_BMM150-7183_di03.2.1.11696_170103.fw");
  sprintf(firmware_path, "../../../Bosch_PCB_7183_di03_BMI160_AK09911-7183_di03.2.1.11696_170103.fw");
  //sprintf(firmware_path, "../../../Bosch_PCB_7183_di03_BMI160_AK09912-7183_di03.2.1.11696_170103.fw");
  //sprintf(firmware_path, "../../../Bosch_PCB_7183_di03_BMI160_YAS532B-7183_di03.2.1.11696_170103.fw");
  sprintf(spec_path, "%s.txt", firmware_path);
  FILE *fp = fopen(spec_path, "w");
  fprintf(fp, "\n");
  fclose(fp);
  fp = fopen(firmware_path, "rb");
  if (fp) {
    fseek(fp, 0, SEEK_END);
    size_t size = ftell(fp);
    BSX_U8 *bhy1_fw = new BSX_U8[size];
    fseek(fp, 0, SEEK_SET);
    fread(bhy1_fw, 1, size, fp);
    fclose(fp);
    for(size_t offset = 0; offset < size; offset++) {
      BSX_U8 *ptr = (BSX_U8 *)&bhy1_fw[offset];
      BSX_U16 length = *((BSX_U16 *)ptr);
      if (length > 0 && length + offset <= size) {
        int verify = bsx_crc(ptr);
        if (verify == 0) {
          printf("[%d] ", offset);
          if (length == 37) {
            ts_accsensorspec ts_bma_spec;
            genericaccspec_setSensorSpec(&ts_bma_spec, ptr);
            fp = fopen(spec_path, "a+");
            fprintf(fp, "unsigned char bma_spec[] = {");
            for (int i = 0; i < length; i++) {
              fprintf(fp, "%d,", ptr[i]);
            }
            fprintf(fp, "};\n");
            fclose(fp);
          } else if (length == 14) {
            ts_gyrosensorspec ts_bmg_spec;
            genericgyrospec_setSensorSpec(&ts_bmg_spec, ptr);
            fp = fopen(spec_path, "a+");
            fprintf(fp, "unsigned char bmg_spec[] = {", offset);
            for (int i = 0; i < length; i++) {
              fprintf(fp, "%d,", ptr[i]);
            }
            fprintf(fp, "};\n");
            fclose(fp);
          } else if (length == 39) {
            ts_magsensorspec ts_bmm_spec;
            genericmagspec_setSensorSpec(&ts_bmm_spec, ptr);
            fp = fopen(spec_path, "a+");
            fprintf(fp, "unsigned char bmm_spec[] = {", offset);
            for (int i = 0; i < length; i++) {
              fprintf(fp, "%d,", ptr[i]);
            }
            fprintf(fp, "};\n");
            fclose(fp);
          } else if (length == 1666) {
            printf("USECASE spec\n");
            fp = fopen(spec_path, "a+");
            fprintf(fp, "unsigned char usecase_spec[] = {", offset);
            for (int i = 0; i < length; i++) {
              fprintf(fp, "%d,", ptr[i]);
            }
            fprintf(fp, "};\n");
            fclose(fp);
          } else {
            for (int i = 0; i < length && i < 100; i++) {
              printf("%d,", ptr[i]);
            }
            if (length >= 100) {
              printf(" ...");
            }
            printf("\n");
          }
        }
      }
    }
    printf("DONE\n");
    delete bhy1_fw;
  }
  BSX_F32 A[]={1,-1,1,-4,5,-4,3,12,2,1,1,11,2,-1,7,-1};
  BSX_F32 E[]={1,0,0,0,0,1,0,0,0,0,1,0,0,0,0,1};
  BSX_F32 O[]={1,0,0,0,0,1,0,0,0,0,1,0,0,0,0,1};
  MATRIX_Inverse(A, O, 4, 1);
  for (int i = 0; i < 4; i++){
    for (int j = 0; j < 4; j++){
      printf("%f ", O[i * 4 + j]);
    }
    printf("\n");
  }
  BSX_F32 C[]={1,-1,-4,5,-4,12,2,1,11};
  BSX_F32 D[]={1,0,0,0,0,0,0,1,0,0,0,0,0,0,1,0,0,0};
  BSX_F32 F[]={1,0,0,0,0,0,0,1,0,0,0,0,0,0,1,0,0,0};
  MATRIX_GaussJordanElimination(3, 3, 6, C, D, F);
  for (int i = 0; i < 3; i++){
    for (int j = 0; j < 6; j++){
      printf("%f ", F[i * 6 + j]);
    }
    printf("\n");
  }
  printf("%f %f %f %f\n", 1.0f / sqrt(-2.0f), invSqrtF(-2.0f), 1.0 / sqrt(-2.0), invSqrtF(-2.0));
  BSX_U8 mm = 32;
  float xxx = (float)-mm;
  printf("%f\n", xxx);
  getchar();
  return 0;
}

